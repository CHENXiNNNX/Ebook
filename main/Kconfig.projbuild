## main/Kconfig.projbuild
```kconfig
menu "Ebook 存储"

    config EBOOK_STORAGE_FORMAT_IF_MOUNT_FAILED
        bool "挂载失败时格式化 userdata/assets"
        default y
        help
            开启: userdata (FAT) 与 assets (LittleFS) 在挂载失败时会由驱动尝试格式化后再挂载。
            关闭: 挂载失败直接返回错误, 不自动格式化。
            从 LittleFS 迁移到 FAT 后首次启动建议保持开启, 会自动格式化 userdata。

    config EBOOK_INTERNAL_MAX_FILES
        int "userdata FAT 最大同时打开文件数"
        range 4 32
        default 10
        help
            /int 分区 (FAT) 允许同时打开的最大文件数。

    menu "Flash 预置镜像"
        config EBOOK_FLASH_EMBED_ASSETS
            bool "构建并烧录 assets (LittleFS) 镜像"
            default y
            help
                开启: 从 assets/littlefs_assets 生成 assets.bin,
                并在 idf.py flash 时写入 assets 分区。
                关闭: 跳过镜像生成与烧录

        config EBOOK_FLASH_EMBED_USERDATA
            bool "构建并烧录 userdata (FAT) 镜像"
            default y
            help
                开启: 从 assets/fat_userdata 生成 userdata FAT 镜像,
                并在 idf.py flash 时写入 userdata 分区。
                关闭: 跳过镜像生成与烧录

    endmenu

    menu "SD 卡 (SDMMC, 挂载 /sd)"
        depends on SOC_SDMMC_HOST_SUPPORTED

        config EBOOK_SD_SDMMC_ENABLE
            bool "启用 SDMMC 挂载"
            default y
            help
                关闭后 mount_sd() 固定返回 ESP_ERR_NOT_SUPPORTED。
                引脚、总线宽度、CD 检测均由 config.hpp 中 TF_CARD_* 自动推断。

        config EBOOK_SD_SPEED_HS
            bool "SDMMC High Speed 模式"
            depends on EBOOK_SD_SDMMC_ENABLE
            default n

        config EBOOK_SD_FORMAT_IF_MOUNT_FAILED
            bool "挂载失败时对 SD 卡分区并格式化"
            depends on EBOOK_SD_SDMMC_ENABLE
            default n
            help
                与片内 userdata/assets 的格式化选项无关。慎用, 否则可能误清空 TF 卡数据。

        config EBOOK_SD_HOTPLUG_SERVICE_MS
            int "热插拔轮询间隔"
            depends on EBOOK_SD_SDMMC_ENABLE
            default 500
            range 100 30000
            help
                TF_CARD_CD 为 NC 时: 软件轮询尝试 mount_sd 的最小间隔。
                TF_CARD_CD 有效时: 读取 CD 电平并决策的最小间隔。

        config EBOOK_SD_MAX_FILES
            int "FAT 同时打开文件数上限"
            depends on EBOOK_SD_SDMMC_ENABLE
            default 5
            range 1 16

    endmenu

endmenu

menu "高德API Key"

    config EBOOK_AMAP_WEATHER_KEY
        string "高德 Web 服务 API Key"
        default ""
        help
            在 https://lbs.amap.com 控制台申请 Web 服务 Key。
            API接口: 天气查询和IP定位
            留空时天气 App 提示未配置 Key。

endmenu
```

## sdkconfig.defaults
```kconfig
# esptool
CONFIG_ESPTOOLPY_FLASHMODE_QIO=y

# compiler
CONFIG_COMPILER_OPTIMIZATION_SIZE=y
CONFIG_COMPILER_CXX_EXCEPTIONS=n
CONFIG_COMPILER_CXX_RTTI=n

# bootloader
CONFIG_BOOTLOADER_COMPILER_OPTIMIZATION_PERF=y
CONFIG_BOOTLOADER_LOG_LEVEL_NONE=y
CONFIG_BOOTLOADER_SKIP_VALIDATE_ALWAYS=y
CONFIG_BOOTLOADER_APP_ROLLBACK_ENABLE=y

# httpd
CONFIG_HTTPD_MAX_REQ_HDR_LEN=2048
CONFIG_HTTPD_MAX_URI_LEN=2048

# freertos
CONFIG_ESP_TASK_WDT_TIMEOUT_S=10
CONFIG_FREERTOS_GENERATE_RUN_TIME_STATS=y
CONFIG_FREERTOS_USE_STATS_FORMATTING_FUNCTIONS=y
CONFIG_FREERTOS_HZ=1000

# stacks
CONFIG_ESP_MAIN_TASK_STACK_SIZE=32768
CONFIG_ESP_SYSTEM_EVENT_TASK_STACK_SIZE=4096

# mbedtls
CONFIG_MBEDTLS_DYNAMIC_BUFFER=y
CONFIG_MBEDTLS_SSL_KEEP_PEER_CERTIFICATE=n
CONFIG_MBEDTLS_DYNAMIC_FREE_CONFIG_DATA=y
CONFIG_MBEDTLS_SSL_RENEGOTIATION=n
CONFIG_MBEDTLS_CERTIFICATE_BUNDLE=y
CONFIG_MBEDTLS_CERTIFICATE_BUNDLE_DEFAULT_FULL=y

# esp_audio_codec（音乐：仅 MP3 解码 + WAV 容器）
CONFIG_AUDIO_DECODER_MP3_SUPPORT=y
CONFIG_AUDIO_DECODER_PCM_SUPPORT=y
CONFIG_AUDIO_SIMPLE_DEC_WAV_SUPPORT=y
CONFIG_AUDIO_DECODER_AAC_SUPPORT=n
CONFIG_AUDIO_DECODER_G711_SUPPORT=n
CONFIG_AUDIO_DECODER_AMRNB_SUPPORT=n
CONFIG_AUDIO_DECODER_AMRWB_SUPPORT=n
CONFIG_AUDIO_DECODER_FLAC_SUPPORT=n
CONFIG_AUDIO_DECODER_OPUS_SUPPORT=n
CONFIG_AUDIO_DECODER_VORBIS_SUPPORT=n
CONFIG_AUDIO_DECODER_ADPCM_SUPPORT=n
CONFIG_AUDIO_DECODER_ALAC_SUPPORT=n
CONFIG_AUDIO_DECODER_SBC_SUPPORT=n
CONFIG_AUDIO_DECODER_LC3_SUPPORT=n
CONFIG_AUDIO_DECODER_G722_SUPPORT=n
CONFIG_AUDIO_SIMPLE_DEC_M4A_SUPPORT=n
CONFIG_AUDIO_SIMPLE_DEC_TS_SUPPORT=n
CONFIG_AUDIO_SIMPLE_DEC_OGG_SUPPORT=n

# wifi
CONFIG_ESP_WIFI_IRAM_OPT=n
CONFIG_ESP_WIFI_RX_IRAM_OPT=n
CONFIG_ESP_WIFI_DYNAMIC_RX_MGMT_BUFFER=y
CONFIG_ESP_WIFI_STATIC_RX_BUFFER_NUM=3
CONFIG_ESP_WIFI_DYNAMIC_RX_BUFFER_NUM=6
CONFIG_ESP_WIFI_RX_BA_WIN=3

# lwip
CONFIG_LWIP_TCPIP_RECVMBOX_SIZE=16

# newlib
CONFIG_NEWLIB_NANO_FORMAT=y

# ble / nimble
CONFIG_BT_ENABLED=y
CONFIG_BT_BLUEDROID_ENABLED=n
CONFIG_BT_NIMBLE_ENABLED=y
CONFIG_BT_CONTROLLER_ENABLED=y
CONFIG_BT_NIMBLE_MAX_CONNECTIONS=3
CONFIG_BT_NIMBLE_ROLE_PERIPHERAL=y
CONFIG_BT_NIMBLE_ROLE_BROADCASTER=y
CONFIG_BT_NIMBLE_ROLE_CENTRAL=y
CONFIG_BT_NIMBLE_ROLE_OBSERVER=y
CONFIG_BT_NIMBLE_MAX_BONDS=3
CONFIG_BT_NIMBLE_PINNED_TO_CORE_0=y
CONFIG_BT_NIMBLE_TASK_STACK_SIZE=4096
CONFIG_BT_NIMBLE_MEM_ALLOC_MODE_INTERNAL=y
CONFIG_BT_NIMBLE_LOG_LEVEL_ERROR=y

# esp_codec_dev
CONFIG_CODEC_ES8311_SUPPORT=y

# fatfs
CONFIG_FATFS_LFN_HEAP=y
CONFIG_FATFS_MAX_LFN=255
CONFIG_FATFS_API_ENCODING_UTF_8=y
```

## sdkconfig.defaults.esp32s3
```kconfig
# Console on UART0 (U0TXD/U0RXD, typically GPIO43/44 on ESP32-S3 module).
# Use a USB-UART adapter on the breakout pins for idf.py flash monitor.
# Board USB port is reserved for future OTG / MSC (Transfer app).
CONFIG_ESP_CONSOLE_UART_DEFAULT=y
CONFIG_ESP_CONSOLE_UART_NUM=0
CONFIG_ESP_CONSOLE_UART_BAUDRATE=115200
CONFIG_ESPTOOLPY_MONITOR_BAUD=115200
CONFIG_ESP_CONSOLE_SECONDARY_NONE=y
CONFIG_USJ_ENABLE_USB_SERIAL_JTAG=n

# userdata USB MSC
CONFIG_TINYUSB_MSC_ENABLED=y
CONFIG_TINYUSB_MSC_BUFSIZE=8192
# The WL sector must be 4096; otherwise, it will result in the failure of the first startup mount and the erasure of the factory-installed content.
CONFIG_WL_SECTOR_SIZE_4096=y

CONFIG_ESPTOOLPY_FLASHSIZE_16MB=y

# partition table
CONFIG_PARTITION_TABLE_CUSTOM=y
CONFIG_PARTITION_TABLE_CUSTOM_FILENAME="partitions/partition_16mb.csv"
CONFIG_PARTITION_TABLE_OFFSET=0x8000

# cpu
CONFIG_ESP_DEFAULT_CPU_FREQ_MHZ_240=y

# psram
CONFIG_SPIRAM_XIP_FROM_PSRAM=y
CONFIG_ESP32S3_INSTRUCTION_CACHE_32KB=y
CONFIG_ESP32S3_DATA_CACHE_64KB=y
CONFIG_ESP32S3_DATA_CACHE_LINE_64B=y

# spiram (octal)
CONFIG_SPIRAM=y
CONFIG_SPIRAM_MODE_OCT=y
CONFIG_SPIRAM_SPEED_80M=y
CONFIG_SPIRAM_MALLOC_ALWAYSINTERNAL=512
CONFIG_SPIRAM_MALLOC_RESERVE_INTERNAL=65536
CONFIG_SPIRAM_MEMTEST=n
CONFIG_MBEDTLS_EXTERNAL_MEM_ALLOC=y
```
